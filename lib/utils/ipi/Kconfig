## lib/utils/ipi/Kconfig
```kconfig
# SPDX-License-Identifier: BSD-2-Clause

menu "IPI Device Support"

config FDT_IPI
	bool "FDT based ipi drivers"
	depends on FDT
	default n

if FDT_IPI

config FDT_IPI_MSWI
	bool "ACLINT MSWI FDT driver"
	select IPI_MSWI
	default n

config FDT_IPI_PLICSW
	bool "Andes PLICSW FDT driver"
	select IPI_PLICSW
	default n


config FDT_IPI_ICCM_MMIO
	bool "Syntacore ICCM MMIO FDT driver"
	select IPI_ICCM_MMIO
	default n

config FDT_IPI_ICCM
	bool "Syntacore ICCM FDT driver"
	select IPI_ICCM
	default n
endif

config IPI_MSWI
	bool "ACLINT MSWI support"
	default n

config IPI_PLICSW
	bool "Andes PLICSW support"
	default n

config IPI_ICCM_MMIO
	bool "Syntacore ICCM MMIO support"
	default n

config IPI_ICCM
	bool "Syntacore ICCM support"
	default n

endmenu
```

## lib/utils/timer/Kconfig
```kconfig
# SPDX-License-Identifier: BSD-2-Clause

menu "Timer Device Support"

config FDT_TIMER
	bool "FDT based timer drivers"
	depends on FDT
	default n

if FDT_TIMER

config FDT_TIMER_MTIMER
	bool "ACLINT MTIMER FDT driver"
	select TIMER_MTIMER
	default n

config FDT_TIMER_PLMT
	bool "Andes PLMT FDT driver"
	select TIMER_PLMT
	default n

config FDT_TIMER_SCR
	bool "Syntacore MTIMER FDT driver"
	select TIMER_SCR
	default y

endif

config TIMER_MTIMER
	bool "ACLINT MTIMER support"
	default n

config TIMER_PLMT
	bool "Andes PLMT support"
	default n

config TIMER_SCR
	bool "Syntacore MTIMER support"
	default n

endmenu
```

## lib/utils/ud/Kconfig
```kconfig
# SPDX-License-Identifier: BSD-2-Clause

menu "Unified Discovery support"

config UNIFIED_DISCOVERY
	bool "Unified discovery"
	default y

endmenu
```

## platform/syntacore/configs/htg960_scr7_defconfig
```kconfig
CONFIG_PLATFORM_SYNTACORE=y
CONFIG_PLATFORM_SYNTACORE_SCR7=y
CONFIG_PLATFORM_SYNTACORE_SDK_HTG960=y
CONFIG_PLATFORM_SYNTACORE_PMP=y
CONFIG_PLATFORM_SYNTACORE_BUNDLED_FDT=y
CONFIG_PLATFORM_SYNTACORE_BUNDLED_FDT_NAME="htg960_scr7"
CONFIG_PLATFORM_SYNTACORE_CLOCK_FREQUENCY=50000000
CONFIG_PLATFORM_SYNTACORE_DRAM_SIZE=0x3fc000000
CONFIG_PLATFORM_SYNTACORE_DRAM_ORDER=34
CONFIG_PLATFORM_SYNTACORE_DMA_ORDER=26
```

## platform/syntacore/configs/htg960_scr9_defconfig
```kconfig
CONFIG_PLATFORM_SYNTACORE=y
CONFIG_PLATFORM_SYNTACORE_SCR9=y
CONFIG_PLATFORM_SYNTACORE_SDK_HTG960=y
CONFIG_PLATFORM_SYNTACORE_PMP=y
CONFIG_PLATFORM_SYNTACORE_BUNDLED_FDT=y
CONFIG_PLATFORM_SYNTACORE_BUNDLED_FDT_NAME="htg960_scr9"
CONFIG_PLATFORM_SYNTACORE_NR_CPUS=1
CONFIG_PLATFORM_SYNTACORE_CLOCK_FREQUENCY=80000000
CONFIG_PLATFORM_SYNTACORE_DRAM_SIZE=0x1fc000000
CONFIG_PLATFORM_SYNTACORE_DRAM_ORDER=33
CONFIG_PLATFORM_SYNTACORE_DMA_ORDER=26
```

## platform/syntacore/configs/vcu118_scr5_defconfig
```kconfig
CONFIG_PLATFORM_SYNTACORE=y
CONFIG_PLATFORM_SYNTACORE_SCR5=y
CONFIG_PLATFORM_SYNTACORE_SWPW=y
CONFIG_PLATFORM_SYNTACORE_SDK_VCU118=y
CONFIG_PLATFORM_SYNTACORE_BUNDLED_FDT=y
CONFIG_PLATFORM_SYNTACORE_BUNDLED_FDT_NAME="vcu118_scr5"
```

## platform/syntacore/configs/vcu118_scr5_rv32_defconfig
```kconfig
CONFIG_PLATFORM_SYNTACORE=y
CONFIG_PLATFORM_SYNTACORE_SCR5=y
CONFIG_PLATFORM_SYNTACORE_SWPW=y
CONFIG_PLATFORM_SYNTACORE_SDK_VCU118=y
CONFIG_PLATFORM_SYNTACORE_BUNDLED_FDT=y
CONFIG_PLATFORM_SYNTACORE_BUNDLED_FDT_NAME="vcu118_scr5"
CONFIG_PLATFORM_SYNTACORE_DRAM_SIZE=0x3f000000
CONFIG_PLATFORM_SYNTACORE_DRAM_ORDER=30
CONFIG_PLATFORM_SYNTACORE_NR_CPUS=1
CONFIG_PLATFORM_SYNTACORE_MPU=y
CONFIG_PLATFORM_SYNTACORE_DMA_ORDER=22
```

## platform/syntacore/configs/vcu118_scr7_defconfig
```kconfig
CONFIG_PLATFORM_SYNTACORE=y
CONFIG_PLATFORM_SYNTACORE_SCR7=y
CONFIG_PLATFORM_SYNTACORE_SDK_VCU118=y
CONFIG_PLATFORM_SYNTACORE_PMP=y
CONFIG_PLATFORM_SYNTACORE_BUNDLED_FDT=y
CONFIG_PLATFORM_SYNTACORE_BUNDLED_FDT_NAME="vcu118_scr7"
CONFIG_PLATFORM_SYNTACORE_NR_CPUS=1
```

## platform/syntacore/configs/vcu118_scr9_pmp_defconfig
```kconfig
CONFIG_PLATFORM_SYNTACORE=y
CONFIG_PLATFORM_SYNTACORE_SCR9=y
CONFIG_PLATFORM_SYNTACORE_SDK_VCU118=y
CONFIG_PLATFORM_SYNTACORE_PMP=y
CONFIG_PLATFORM_SYNTACORE_BUNDLED_FDT=y
CONFIG_PLATFORM_SYNTACORE_BUNDLED_FDT_NAME="vcu118_scr9"
```
