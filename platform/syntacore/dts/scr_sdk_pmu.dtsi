/*
 *  Copyright (C) 2022 Syntacore
 */

/ {
	pmu {
		compatible = "riscv,pmu";
		interrupts-extended = <
			&cpu0_intc 13
#if CONFIG_PLATFORM_SYNTACORE_NR_CPUS > 1
			&cpu1_intc 13
#endif
#if CONFIG_PLATFORM_SYNTACORE_NR_CPUS > 2
			&cpu2_intc 13
#endif
#if CONFIG_PLATFORM_SYNTACORE_NR_CPUS > 3
			&cpu3_intc 13
#endif
#if CONFIG_PLATFORM_SYNTACORE_NR_CPUS > 4
			&cpu4_intc 13
#endif
#if CONFIG_PLATFORM_SYNTACORE_NR_CPUS > 5
			&cpu5_intc 13
#endif
#if CONFIG_PLATFORM_SYNTACORE_NR_CPUS > 6
			&cpu6_intc 13
#endif
#if CONFIG_PLATFORM_SYNTACORE_NR_CPUS > 7
			&cpu7_intc 13
#endif
			>;
		riscv,event-to-mhpmcounters =
			<0x04 0x06 0x78>,
			<0x08 0x09 0x78>;
		riscv,event-to-mhpmevent =
			<0x04 0x00000000 0x0000014>,	/* SBI_PMU_HW_CACHE_MISSES -> L1I_MISS */
			<0x05 0x00000000 0x0000012>,	/* SBI_PMU_HW_BRANCH_INSTRUCTIONS -> PRD_BRANCH */
			<0x06 0x00000000 0x0000092>,	/* SBI_PMU_HW_BRANCH_MISSES -> PRD_BR_MIS */
			<0x08 0x00000000 0x00000e3>,	/* SBI_PMU_HW_STALLED_CYCLES_FRONTEND -> EXC_ST_ISS */
			<0x09 0x00000000 0x0000083>,	/* SBI_PMU_HW_STALLED_CYCLES_BACKEND -> EXC_BE_IDLE */
			<0x10000 0x00000000 0x0000005>,	/* L1D_READ_ACCESS -> L1D_HIT */
			<0x10001 0x00000000 0x0000015>,	/* L1D_READ_MISS -> L1D_MISS */
			<0x10004 0x00000000 0x0000045>,	/* L1D_PREFETCH_ACCESS -> L1D_PREF_HIT */
			<0x10005 0x00000000 0x0000055>,	/* L1D_PREFETCH_MISS -> L1D_PREF_MISS */
			<0x10008 0x00000000 0x0000004>,	/* L1I_READ_ACCESS -> L1I_HIT */
			<0x10009 0x00000000 0x0000014>,	/* L1I_READ_MISS -> L1I_MISS */
			<0x1000c 0x00000000 0x0000034>,	/* L1I_PREFETCH_ACCESS -> L1I_PREF_HIT */
			<0x1000d 0x00000000 0x0000044>,	/* L1I_PREFETCH_MISS -> L1I_PREF_MISS */
			<0x10018 0x00000000 0x0000065>,	/* DTLB_READ_ACCESS -> L1D_TLB_ACCESS */
			<0x10019 0x00000000 0x0000075>,	/* DTLB_READ_MISS -> L1D_TLB_MISS */
			<0x10028 0x00000000 0x0000012>,	/* BPU_READ_ACCESS -> PRD_BRANCH */
			<0x10029 0x00000000 0x0000092>;	/* BPU_READ_MISS -> PRD_BR_MIS */
		riscv,raw-event-to-mhpmcounters =
			/* General group */
			<0x00000000 0x0000001 0xffffffff 0xffffffff 0x78>, /* GEN_CYC */
			<0x00000000 0x0000021 0xffffffff 0xffffffff 0x78>, /* GEN_INST */
			<0x00000000 0x0000031 0xffffffff 0xffffffff 0x78>, /* GEN_ISS */
			<0x00000000 0x0000041 0xffffffff 0xffffffff 0x78>, /* GEN_SPEC_EXC */
			<0x00000000 0x0000061 0xffffffff 0xffffffff 0x78>, /* GEN_STRAP */
			<0x00000000 0x0000071 0xffffffff 0xffffffff 0x78>, /* GEN_MTRAP */
			<0x00000000 0x0000081 0xffffffff 0xffffffff 0x78>, /* GEN_URET */
			<0x00000000 0x0000091 0xffffffff 0xffffffff 0x78>, /* GEN_SRET */
			<0x00000000 0x00000a1 0xffffffff 0xffffffff 0x78>, /* GEN_MRET */
			/* Prediction group */
			<0x00000000 0x0000002 0xffffffff 0xffffffff 0x78>, /* PRD_CFI */
			<0x00000000 0x0000012 0xffffffff 0xffffffff 0x78>, /* PRD_BRANCH */
			<0x00000000 0x0000022 0xffffffff 0xffffffff 0x78>, /* PRD_CALL */
			<0x00000000 0x0000032 0xffffffff 0xffffffff 0x78>, /* PRD_RET */
			<0x00000000 0x0000042 0xffffffff 0xffffffff 0x78>, /* PRD_DIR_JMP */
			<0x00000000 0x0000052 0xffffffff 0xffffffff 0x78>, /* PRD_REL_JMP */
			<0x00000000 0x0000062 0xffffffff 0xffffffff 0x78>, /* PRD_CFI_MIS */
			<0x00000000 0x0000072 0xffffffff 0xffffffff 0x78>, /* PRD_CALL_MIS */
			<0x00000000 0x0000082 0xffffffff 0xffffffff 0x78>, /* PRD_RET_MIS */
			<0x00000000 0x0000092 0xffffffff 0xffffffff 0x78>, /* PRD_BR_MIS */
			/* Execution group */
			<0x00000000 0x0000003 0xffffffff 0xffffffff 0x78>, /* EXC_INT_RTR */
			<0x00000000 0x0000013 0xffffffff 0xffffffff 0x78>, /* EXC_FP_RTR */
			<0x00000000 0x0000023 0xffffffff 0xffffffff 0x78>, /* EXC_MEM_RTR */
			<0x00000000 0x0000033 0xffffffff 0xffffffff 0x78>, /* EXC_0IPC_RTR */
			<0x00000000 0x0000043 0xffffffff 0xffffffff 0x78>, /* EXC_1IPC_RTR */
			<0x00000000 0x0000053 0xffffffff 0xffffffff 0x78>, /* EXC_2IPC_RTR */
			<0x00000000 0x0000063 0xffffffff 0xffffffff 0x78>, /* EXC_3IPC_RTR */
			<0x00000000 0x0000073 0xffffffff 0xffffffff 0x78>, /* EXC_4IPC_RTR */
			<0x00000000 0x0000083 0xffffffff 0xffffffff 0x78>, /* EXC_BE_IDLE */
			<0x00000000 0x0000093 0xffffffff 0xffffffff 0x78>, /* EXC_W_ALUMUL */
			<0x00000000 0x00000a3 0xffffffff 0xffffffff 0x78>, /* EXC_W_ALUDIV */
			<0x00000000 0x00000b3 0xffffffff 0xffffffff 0x78>, /* EXC_W_FPU */
			<0x00000000 0x00000c3 0xffffffff 0xffffffff 0x78>, /* EXC_W_LSU */
			<0x00000000 0x00000d3 0xffffffff 0xffffffff 0x78>, /* EXC_W_CSR */
			<0x00000000 0x00000e3 0xffffffff 0xffffffff 0x78>, /* EXC_ST_ISS */
			<0x00000000 0x00000f3 0xffffffff 0xffffffff 0x78>, /* EXC_ST_SRCT */
			<0x00000000 0x0000103 0xffffffff 0xffffffff 0x78>, /* EXC_ST_INT */
			<0x00000000 0x0000113 0xffffffff 0xffffffff 0x78>, /* EXC_ST_LSU */
			<0x00000000 0x0000123 0xffffffff 0xffffffff 0x78>, /* EXC_ST_FPU */
			/* L1I group */
			<0x00000000 0x0000004 0xffffffff 0xffffffff 0x78>, /* L1I_HIT */
			<0x00000000 0x0000014 0xffffffff 0xffffffff 0x78>, /* L1I_MISS */
			<0x00000000 0x0000024 0xffffffff 0xffffffff 0x78>, /* L1I_REFILL */
			<0x00000000 0x0000034 0xffffffff 0xffffffff 0x78>, /* L1I_PREF_HIT */
			<0x00000000 0x0000044 0xffffffff 0xffffffff 0x78>, /* L1I_PREF_MISS */
			<0x00000000 0x0000054 0xffffffff 0xffffffff 0x78>, /* L1I_PREF_REFILL */
			<0x00000000 0x0000064 0xffffffff 0xffffffff 0x78>, /* L1I_TLB_ACCESS */
			<0x00000000 0x0000074 0xffffffff 0xffffffff 0x78>, /* L1I_TLB_MISS */
			<0x00000000 0x0000084 0xffffffff 0xffffffff 0x78>, /* L1I_SNP */
			<0x00000000 0x0000094 0xffffffff 0xffffffff 0x78>, /* L1I_SNP_DUMMY */
			<0x00000000 0x00000a4 0xffffffff 0xffffffff 0x78>, /* L1I_EVICT */
			<0x00000000 0x00000b4 0xffffffff 0xffffffff 0x78>, /* L1I_NC_REQ */
			<0x00000000 0x00000c4 0xffffffff 0xffffffff 0x78>, /* L1I_SO_REQ */
			/* L1D group */
			<0x00000000 0x0000005 0xffffffff 0xffffffff 0x78>, /* L1D_HIT */
			<0x00000000 0x0000015 0xffffffff 0xffffffff 0x78>, /* L1D_MISS */
			<0x00000000 0x0000025 0xffffffff 0xffffffff 0x78>, /* L1D_REFILL */
			<0x00000000 0x0000035 0xffffffff 0xffffffff 0x78>, /* L1D_PREF_HIT */
			<0x00000000 0x0000045 0xffffffff 0xffffffff 0x78>, /* L1D_PREF_MISS */
			<0x00000000 0x0000055 0xffffffff 0xffffffff 0x78>, /* L1D_PREF_REFILL */
			<0x00000000 0x0000065 0xffffffff 0xffffffff 0x78>, /* L1D_TLB_ACCESS */
			<0x00000000 0x0000075 0xffffffff 0xffffffff 0x78>, /* L1D_TLB_MISS */
			<0x00000000 0x0000085 0xffffffff 0xffffffff 0x78>, /* L1D_SNP */
			<0x00000000 0x0000095 0xffffffff 0xffffffff 0x78>, /* L1D_SNP_DUMMY */
			<0x00000000 0x00000a5 0xffffffff 0xffffffff 0x78>, /* L1D_EVICT */
			<0x00000000 0x00000b5 0xffffffff 0xffffffff 0x78>, /* L1D_NC_REQ */
			<0x00000000 0x00000c5 0xffffffff 0xffffffff 0x78>, /* L1D_SO_REQ */
			<0x00000000 0x00000d5 0xffffffff 0xffffffff 0x78>, /* L1D_LD_SPEC */
			<0x00000000 0x00000e5 0xffffffff 0xffffffff 0x78>, /* L1D_ST_SPEC */
			<0x00000000 0x00000f5 0xffffffff 0xffffffff 0x78>, /* L1D_FENCE_SPEC */
			<0x00000000 0x0000105 0xffffffff 0xffffffff 0x78>, /* L1D_AMO_SPEC */
			<0x00000000 0x0000115 0xffffffff 0xffffffff 0x78>, /* L1D_LR_SPEC */
			<0x00000000 0x0000125 0xffffffff 0xffffffff 0x78>, /* L1D_SC_SPEC */
			<0x00000000 0x0000135 0xffffffff 0xffffffff 0x78>, /* L1D_CM_SPEC */
			/* Exceptions group */
			<0x00000000 0x0000006 0xffffffff 0xffffffff 0x78>, /* TRP_IAF */
			<0x00000000 0x0000016 0xffffffff 0xffffffff 0x78>, /* TRP_ILLEG */
			<0x00000000 0x0000026 0xffffffff 0xffffffff 0x78>, /* TRP_BP */
			<0x00000000 0x0000036 0xffffffff 0xffffffff 0x78>, /* TRP_LAM */
			<0x00000000 0x0000046 0xffffffff 0xffffffff 0x78>, /* TRP_LAF */
			<0x00000000 0x0000056 0xffffffff 0xffffffff 0x78>, /* TRP_SAM */
			<0x00000000 0x0000066 0xffffffff 0xffffffff 0x78>, /* TRP_SAF */
			<0x00000000 0x0000076 0xffffffff 0xffffffff 0x78>, /* TRP_UECALL */
			<0x00000000 0x0000086 0xffffffff 0xffffffff 0x78>, /* TRP_SECALL */
			<0x00000000 0x0000096 0xffffffff 0xffffffff 0x78>, /* TRP_MECALL */
			<0x00000000 0x00000b6 0xffffffff 0xffffffff 0x78>, /* TRP_IPF */
			<0x00000000 0x00000c6 0xffffffff 0xffffffff 0x78>, /* TRP_LPF */
			<0x00000000 0x00000e6 0xffffffff 0xffffffff 0x78>, /* TRP_SPF */
			/* IRQ group */
			<0x00000000 0x0000017 0xffffffff 0xffffffff 0x78>, /* TRP_SSI */
			<0x00000000 0x0000037 0xffffffff 0xffffffff 0x78>, /* TRP_MSI */
			<0x00000000 0x0000057 0xffffffff 0xffffffff 0x78>, /* TRP_STI */
			<0x00000000 0x0000077 0xffffffff 0xffffffff 0x78>, /* TRP_MTI */
			<0x00000000 0x0000097 0xffffffff 0xffffffff 0x78>, /* TRP_SEI */
			<0x00000000 0x00000c7 0xffffffff 0xffffffff 0x78>; /* TRP_MEI */
	};
};
