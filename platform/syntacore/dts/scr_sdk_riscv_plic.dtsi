/*
 * Copyright (C) 2022, Syntacore Ltd.
 *
 * Redistribution and use in source and binary forms, with or without
 * modification, are permitted provided that the following conditions are met:
 *     1. Redistributions of source code must retain the above copyright notice,
 *        this list of conditions and the following disclaimer.
 *     2. Redistributions in binary form must reproduce the above copyright
 *        notice, this list of conditions and the following disclaimer in the
 *        documentation and/or other materials provided with the distribution.
 *     3. Neither the name of the copyright holder nor the names of its
 *        contributors may be used to endorse or promote products derived from
 *        this software without specific prior written permission.
 *
 * THIS SOFTWARE IS PROVIDED BY THE COPYRIGHT HOLDERS AND CONTRIBUTORS "AS IS" AND
 * ANY EXPRESS OR IMPLIED WARRANTIES, INCLUDING, BUT NOT LIMITED TO, THE IMPLIED
 * WARRANTIES OF MERCHANTABILITY AND FITNESS FOR A PARTICULAR PURPOSE ARE
 * DISCLAIMED. IN NO EVENT SHALL THE COPYRIGHT HOLDER OR CONTRIBUTORS BE LIABLE
 * FOR ANY DIRECT, INDIRECT, INCIDENTAL, SPECIAL, EXEMPLARY, OR CONSEQUENTIAL
 * DAMAGES (INCLUDING, BUT NOT LIMITED TO, PROCUREMENT OF SUBSTITUTE GOODS OR
 * SERVICES; LOSS OF USE, DATA, OR PROFITS; OR BUSINESS INTERRUPTION) HOWEVER
 * CAUSED AND ON ANY THEORY OF LIABILITY, WHETHER IN CONTRACT, STRICT LIABILITY,
 * OR TORT (INCLUDING NEGLIGENCE OR OTHERWISE) ARISING IN ANY WAY OUT OF THE USE
 * OF THIS SOFTWARE, EVEN IF ADVISED OF THE POSSIBILITY OF SUCH DAMAGE.
 */

/ {
	plic: interrupt-controller@fffffffe000000 {
		#interrupt-cells = <2>;
		#address-cells = <2>;
		#size-cells = <2>;

		compatible = "syntacore,plic", "sifive,plic-1.0.0", "riscv,plic0";
		interrupt-controller;

		interrupts-extended = <
			&cpu0_intc (-1) &cpu0_intc 9
#if CONFIG_PLATFORM_SYNTACORE_NR_CPUS > 1
			&cpu1_intc (-1) &cpu1_intc 9
#endif
#if CONFIG_PLATFORM_SYNTACORE_NR_CPUS > 2
			&cpu2_intc (-1) &cpu2_intc 9
#endif
#if CONFIG_PLATFORM_SYNTACORE_NR_CPUS > 3
			&cpu3_intc (-1) &cpu3_intc 9
#endif
#if CONFIG_PLATFORM_SYNTACORE_NR_CPUS > 4
			&cpu4_intc (-1) &cpu4_intc 9
#endif
#if CONFIG_PLATFORM_SYNTACORE_NR_CPUS > 5
			&cpu5_intc (-1) &cpu5_intc 9
#endif
#if CONFIG_PLATFORM_SYNTACORE_NR_CPUS > 6
			&cpu6_intc (-1) &cpu6_intc 9
#endif
#if CONFIG_PLATFORM_SYNTACORE_NR_CPUS > 7
			&cpu7_intc (-1) &cpu7_intc 9
#endif
		>;

		reg = <0xffffff 0xfe000000 0x0 0x300000>;
		reg-names = "control";
		riscv,max-priority = <7>;
		riscv,ndev = <16>;
		interrupt-parent = <&cpu0_intc>;
	};
};
