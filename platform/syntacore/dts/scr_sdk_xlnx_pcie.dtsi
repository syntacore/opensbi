/*
 * Copyright (C) 2016, Syntacore Ltd.
 *
 * Redistribution and use in source and binary forms, with or without
 * modification, are permitted provided that the following conditions are met:
 *     1. Redistributions of source code must retain the above copyright notice,
 *        this list of conditions and the following disclaimer.
 *     2. Redistributions in binary form must reproduce the above copyright
 *        notice, this list of conditions and the following disclaimer in the
 *        documentation and/or other materials provided with the distribution.
 *     3. Neither the name of the copyright holder nor the names of its
 *        contributors may be used to endorse or promote products derived from
 *        this software without specific prior written permission.
 *
 * THIS SOFTWARE IS PROVIDED BY THE COPYRIGHT HOLDERS AND CONTRIBUTORS "AS IS" AND
 * ANY EXPRESS OR IMPLIED WARRANTIES, INCLUDING, BUT NOT LIMITED TO, THE IMPLIED
 * WARRANTIES OF MERCHANTABILITY AND FITNESS FOR A PARTICULAR PURPOSE ARE
 * DISCLAIMED. IN NO EVENT SHALL THE COPYRIGHT HOLDER OR CONTRIBUTORS BE LIABLE
 * FOR ANY DIRECT, INDIRECT, INCIDENTAL, SPECIAL, EXEMPLARY, OR CONSEQUENTIAL
 * DAMAGES (INCLUDING, BUT NOT LIMITED TO, PROCUREMENT OF SUBSTITUTE GOODS OR
 * SERVICES; LOSS OF USE, DATA, OR PROFITS; OR BUSINESS INTERRUPTION) HOWEVER
 * CAUSED AND ON ANY THEORY OF LIABILITY, WHETHER IN CONTRACT, STRICT LIABILITY,
 * OR TORT (INCLUDING NEGLIGENCE OR OTHERWISE) ARISING IN ANY WAY OUT OF THE USE
 * OF THIS SOFTWARE, EVEN IF ADVISED OF THE POSSIBILITY OF SUCH DAMAGE.
 */

&scr_sdk_soc {
	pci_express: pcie@ffffffc0000000 {
		#address-cells = <3>;
		#interrupt-cells = <1>;
		#size-cells = <2>;
		compatible = "xlnx,axi-pcie-host-1.00.a";
		device_type = "pci";

		interrupt-map = <0 0 0 0 &xil_pcie_intc 0>,
				<0 0 0 1 &xil_pcie_intc 1>,
				<0 0 0 2 &xil_pcie_intc 2>,
				<0 0 0 3 &xil_pcie_intc 3>,
				<0 0 0 4 &xil_pcie_intc 4>,
				<0 0 0 5 &xil_pcie_intc 5>,
				<0 0 0 6 &xil_pcie_intc 6>,
				<0 0 0 7 &xil_pcie_intc 7>;
		interrupt-map-mask = <0 0 0 7>;
		interrupt-parent = <&plic>;
		interrupts = <4 4>;

		bus-range = <0 255>;

		ranges = <0x02000000 0 0 0xffffffff 0xa0000000 0x0 0x20000000>;
		dma-ranges = <0x43000000 0x0 0 0 0 0 0xff000000>;

		reg = <0xffffff 0xc0000000 0x0 0x20000000>;
		reg-names = "control";

		xil_pcie_intc: interrupt-controller {
			#address-cells = <0>;
			#interrupt-cells = <1>;
			interrupt-controller;
		};
	};
};
